## conf/layer.conf
```bitbake
# We have a conf and classes directory, add to BBPATH
BBPATH .= ":${LAYERDIR}"

# We have recipes-* directories, add to BBFILES
BBFILES += "${LAYERDIR}/recipes-*/*/*.bb \
            ${LAYERDIR}/recipes-*/*/*.bbappend"

BBFILE_COLLECTIONS += "meta-nezha-custom"
BBFILE_PATTERN_meta-nezha-custom = "^${LAYERDIR}/"
BBFILE_PRIORITY_meta-nezha-custom = "6"

LAYERDEPENDS_meta-nezha-custom = "core"
LAYERSERIES_COMPAT_meta-nezha-custom = "kirkstone langdale"
```
